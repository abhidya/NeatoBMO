## esp32-body/components/coli_mcu/Kconfig
```kconfig
menu "ESP32 Colibri"

config COLI_MCU_MOUNT_PATH
    string "USB MSC mount path"
    default "/usb"
    help
        VFS path where the component mounts the first FAT-formatted USB MSC
        device. The application remains responsible for installing and
        servicing the singleton USB Host Library.

config COLI_MCU_MODEL_FILE
    string "Colibri model filename"
    default "model.bmoq"

config COLI_MCU_TOKENIZER_FILE
    string "Colibri tokenizer filename"
    default "tokenizer.ctok"

config COLI_MCU_KV_FILE
    string "Colibri paged-state filename"
    default "olmoe.kv"

config COLI_MCU_AUTORUN_DEMO
    bool "Run one generation when storage mounts"
    default n
    help
        Development-only smoke path. Production applications should invoke
        the request API and own output delivery instead of relying on logs.

config COLI_MCU_CONTEXT_TOKENS
    int "Colibri logical context tokens"
    range 2 1048576
    default 4096
    help
        Logical context exposed to the selected model engine. The state stays
        on the writable SSD backend; increasing this value does not allocate
        the full attention state in PSRAM.

config COLI_MCU_DEMO_MAX_NEW_TOKENS
    int "Autorun maximum new tokens"
    range 1 1048575
    default 64
    depends on COLI_MCU_AUTORUN_DEMO

config COLI_MCU_WORKSPACE_BYTES
    int "Inference workspace bytes"
    range 65536 8388608
    default 786432

config COLI_MCU_KV_PAGE_BYTES
    int "Resident SSD KV page bytes"
    range 4096 1048576
    default 65536

endmenu
```

## esp32-body/sdkconfig.defaults
```kconfig
CONFIG_USB_HOST_HUBS_SUPPORTED=y
CONFIG_USB_HOST_HUB_MULTI_LEVEL=y
CONFIG_HTTPD_WS_SUPPORT=y
CONFIG_ESPTOOLPY_FLASHSIZE_16MB=y
CONFIG_MBEDTLS_CERTIFICATE_BUNDLE=y
CONFIG_MBEDTLS_CERTIFICATE_BUNDLE_DEFAULT_FULL=y
CONFIG_SPIRAM=y
CONFIG_SPIRAM_MODE_OCT=y
CONFIG_SPIRAM_TYPE_AUTO=y
CONFIG_SPIRAM_SPEED_80M=y
CONFIG_SPIRAM_BOOT_INIT=y
CONFIG_SPIRAM_USE_MALLOC=y
CONFIG_SPIRAM_MALLOC_ALWAYSINTERNAL=16384
CONFIG_SPIRAM_MALLOC_RESERVE_INTERNAL=32768
```
